## tcsmain/main/Kconfig.projbuild
```kconfig
menu "Application Configuration"

	config GPIO_RANGE_MAX
		int
		default 33 if IDF_TARGET_ESP32
		default 46 if IDF_TARGET_ESP32S2
		default 48 if IDF_TARGET_ESP32S3
		default 19 if IDF_TARGET_ESP32C3
		default 30 if IDF_TARGET_ESP32C6

	choice CAN_BITRATE
		prompt "CAN Bitrate"
		default CAN_BITRATE_500
		help
			Select the CAN bitrate for the example.
		config CAN_BITRATE_25
			bool "BITRATE_25"
		config CAN_BITRATE_50
			bool "BITRATE_50"
		config CAN_BITRATE_100
			bool "BITRATE_100"
		config CAN_BITRATE_125
			bool "BITRATE_125"
		config CAN_BITRATE_250
			bool "BITRATE_250"
		config CAN_BITRATE_500
			bool "BITRATE_500"
		config CAN_BITRATE_800
			bool "BITRATE_800"
		config CAN_BITRATE_1000
			bool "BITRATE_1000"
	endchoice

	config CTX_GPIO
		int "CTX GPIO number"
		range 0 GPIO_RANGE_MAX
		default 21 if IDF_TARGET_ESP32
		default 17 if IDF_TARGET_ESP32S2 || IDF_TARGET_ESP32S3
		default  0 # C3 and others
		help
			GPIO number (IOxx) to CTX.
			Some GPIOs are used for other purposes (flash connections, etc.).
			GPIOs 35-39 are input-only so cannot be used as outputs.

	config CRX_GPIO
		int "CRX GPIO number"
		range 0 GPIO_RANGE_MAX
		default 22 if IDF_TARGET_ESP32
		default 18 if IDF_TARGET_ESP32S2 || IDF_TARGET_ESP32S3
		default  1 # C3 and others
		help
			GPIO number (IOxx) to CRX.
			Some GPIOs are used for other purposes (flash connections, etc.).
			GPIOs 35-39 are input-only so cannot be used as outputs.

endmenu


# New block for your I2C-related settings
menu "Example configuration"

	choice EXAMPLE_I2C_ADDRESS
		prompt "Select I2C address"
		default EXAMPLE_I2C_ADDRESS_GND
		help
			Select I2C address.

		config EXAMPLE_I2C_ADDRESS_GND
			bool "ICM42670_I2C_ADDR_GND (0x68)"
		config EXAMPLE_I2C_ADDRESS_VCC
			bool "ICM42670_I2C_ADDR_VCC (0x69)"
	endchoice

	config EXAMPLE_INT_INPUT_PIN
		int "Interrupt Input Pin GPIO Number"
		default 0
		help
			GPIO number for Interrupt Input Pin

	rsource "../../devtools/Kconfig.i2c"

endmenu

menu "Application Configuration"

    choice POLARITY
        prompt "Communication Polarity"
        default PRIMARY
        help
            Select Communication Polarity.
        config PRIMARY
            bool "Primary"
            help
                As Echo Client.
        config SECONDARY
            bool "Secondary"
            help
                As Echo Server.
    endchoice

endmenu
```
